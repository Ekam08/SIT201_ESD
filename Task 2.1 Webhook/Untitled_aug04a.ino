#include "arduino_secrets.h"
/*
  Sketch generated by the Arduino IoT Cloud Thing

  Arduino IoT Cloud Variables description:
  float temp;
*/

#include "thingProperties.h"
#include "DHT.h"
#include <WiFiNINA.h>
#include "ThingSpeak.h"

// -----------------------------
// DHT Sensor Settings
// -----------------------------
#define DHTPIN 7
#define DHTTYPE DHT22
DHT dht(DHTPIN, DHTTYPE);

// -----------------------------
// WiFi Credentials
// -----------------------------
const char* ssid = "DESKTOP";         // Replace with your Wi-Fi SSID
const char* password = "ekamgaba";    // Replace with your Wi-Fi password

// -----------------------------
// ThingSpeak Settings
// -----------------------------
WiFiClient client;
unsigned long myChannelNumber = 3025190;           // Replace with your ThingSpeak Channel Number
const char* myWriteAPIKey = "F6AQ01FO8T6NN231";     // Replace with your ThingSpeak API key

// -----------------------------

unsigned long lastReadTime = 0;
const unsigned long interval = 30000;  // 30 seconds

void setup() {
  Serial.begin(9600);
  while (!Serial);  // Wait for serial to be ready
  delay(1500);
  Serial.println("Starting setup...");

  // Initialize DHT Sensor
  dht.begin();
  Serial.println("DHT sensor initialized.");

  // Connect to Wi-Fi
  Serial.print("Connecting to WiFi: ");
  Serial.println(ssid);
  WiFi.begin(ssid, password);
  int retryCount = 0;
  while (WiFi.status() != WL_CONNECTED && retryCount < 20) {
    delay(500);
    Serial.print(".");
    retryCount++;
  }

  if (WiFi.status() == WL_CONNECTED) {
    Serial.println("\nWiFi connected.");
    Serial.print("IP Address: ");
    Serial.println(WiFi.localIP());
  } else {
    Serial.println("\nWiFi connection failed! Please check SSID/PASSWORD or proximity.");
  }

  // Initialize ThingSpeak
  ThingSpeak.begin(client);
  Serial.println("ThingSpeak initialized.");

  // Initialize Arduino IoT Cloud
  initProperties();
  ArduinoCloud.begin(ArduinoIoTPreferredConnection);
  setDebugMessageLevel(2);
  ArduinoCloud.printDebugInfo();
  Serial.println("Arduino IoT Cloud initialized.");
}

void loop() {
  ArduinoCloud.update();

  unsigned long currentMillis = millis();

  if (currentMillis - lastReadTime >= interval) {
    lastReadTime = currentMillis;

    float t = dht.readTemperature();

    if (isnan(t)) {
      Serial.println(" Failed to read from DHT sensor!");
      return;
    }

    temp = t;  // Send temperature to Arduino IoT Cloud
    Serial.print(" Temperature: ");
    Serial.print(temp);
    Serial.println(" °C");

    // Send data to ThingSpeak
    ThingSpeak.setField(1, temp);  // Update Field 1
    int status = ThingSpeak.writeFields(myChannelNumber, myWriteAPIKey);

    if (status == 200) {
      Serial.println(" ThingSpeak update successful.");
    } else {
      Serial.print(" ThingSpeak update failed. Error code: ");
      Serial.println(status);
    }
  }
}

void onTempChange() {
  // Optional: Add code here if you want to handle manual changes from IoT Cloud
}
